## CMakeLists.txt
```
cmake_minimum_required(VERSION 3.20.0)
find_package(Zephyr REQUIRED HINTS $ENV{ZEPHYR_BASE})

project(test_led)

# 添加头文件目录
target_include_directories(app PRIVATE include)

# 添加源文件
target_sources(app PRIVATE src/main.c src/led.c)
```

## prj.conf
```kconfig
# 启用 GPIO 支持
CONFIG_GPIO=y

# 启用日志
CONFIG_LOG=y
CONFIG_LOG_DEFAULT_LEVEL=4

# 配置日志输出到 UART
CONFIG_LOG_BACKEND_UART=y
CONFIG_UART_CONSOLE=y
CONFIG_LOG_PRINTK=y
```

## src/main.c
```c
/**
 * @file main.c
 * @brief LED闪烁测试主程序
 *
 * 测试LED驱动：1秒交替亮灭
 */

#include <zephyr/kernel.h>
#include <zephyr/logging/log.h>
#include "led.h"

LOG_MODULE_REGISTER(main, LOG_LEVEL_INF);

int main(void)
{
    printk("=== LED 1秒交替亮灭测试 ===\r\n");
    
    /* 初始化LED */
    led_init();
    
    /* 主循环：1秒交替亮灭 */
    while (1) {
        /* LED 亮 */
        led1_on();
        printk("LED ON\r\n");
        k_busy_wait(1000000);  /* 1秒 = 1000000微秒 */

        /* LED 灭 */
        led1_off();
        printk("LED OFF\r\n");
        k_busy_wait(1000000);  /* 1秒 = 1000000微秒 */
    }

    return 0;
}
```

## include/led.h
```c
/**
 * @file led.h
 * @brief LED驱动头文件
 *
 * 提供LED初始化和控制接口
 */

#ifndef LED_H
#define LED_H

#include <zephyr/kernel.h>

/* LED引脚定义 - nRF52832 DK LED1 */
#define LED_1 17
/* LED引脚定义 - nRF52832 DK LED2 */
#define LED_2 18
/* LED引脚定义 - nRF52832 DK LED3 */
#define LED_3 19
/* LED引脚定义 - nRF52832 DK LED4 */
#define LED_4 20

/**
 * @brief 初始化LED
 *
 * 配置LED引脚为输出模式，初始状态为熄灭
 */
void led_init(void);

/**
 * @brief 点亮LED
 */
void led_on(void);

/**
 * @brief 熄灭LED
 */
void led_off(void);

/**
 * @brief 切换LED状态
 *
 * @return 当前LED状态 (true=亮, false=灭)
 */
bool led_toggle(void);

#endif /* LED_H */
```

## src/led.c
```c
/**
 * @file led.c
 * @brief LED驱动实现
 */

#include "led.h"
#include <hal/nrf_gpio.h>

void led_init(void)
{
    /* 配置 LED 引脚为输出 */
    nrf_gpio_pin_dir_set(LED_1, NRF_GPIO_PIN_DIR_OUTPUT);
    nrf_gpio_pin_dir_set(LED_2, NRF_GPIO_PIN_DIR_OUTPUT);
    nrf_gpio_pin_dir_set(LED_3, NRF_GPIO_PIN_DIR_OUTPUT);
    nrf_gpio_pin_dir_set(LED_4, NRF_GPIO_PIN_DIR_OUTPUT);

    /* 初始熄灭 LED */
    nrf_gpio_pin_set(LED_1);
    nrf_gpio_pin_set(LED_2);
    nrf_gpio_pin_set(LED_3);
    nrf_gpio_pin_set(LED_4);
}

void led1_on(void)
{
    nrf_gpio_pin_clear(LED_1);
}

void led1_off(void)
{
    nrf_gpio_pin_set(LED_1);
}

bool led1_toggle(void)
{
    nrf_gpio_pin_toggle(LED_1);

    /* 返回当前LED状态 */
    return nrf_gpio_pin_read(LED_1) == 0;
}
```
